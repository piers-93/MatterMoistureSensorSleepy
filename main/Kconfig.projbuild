## main/Kconfig.projbuild
```kconfig
menu "Example Configuration"
    config MOISTURE_SENSOR_GPIO
        int "Moisture Sensor GPIO Pin (ADC Input)"
        range 1 5 if IDF_TARGET_ESP32H2
        range 0 6 if IDF_TARGET_ESP32C6
        default 3 if IDF_TARGET_ESP32H2
        default 3 if IDF_TARGET_ESP32C6
        default 3 if IDF_TARGET_ESP32C5
        help
            GPIO number for the moisture sensor analog input.
            ESP32-H2: GPIO1-5 (ADC1_CH0-CH4)
            GPIO2 = ADC1_CH1 (analog output from sensor)

    config MOISTURE_SENSOR_ADC_CHANNEL
        int "ADC Channel Number"
        range 0 4 if IDF_TARGET_ESP32H2
        range 0 6 if IDF_TARGET_ESP32C6
        default 2
        help
            ADC channel for the moisture sensor.
            ESP32-H2: GPIO1=CH0, GPIO2=CH1, GPIO3=CH2, GPIO4=CH3, GPIO5=CH4
            Must match the GPIO selection above!

    config MOISTURE_SENSOR_POWER_GPIO
        int "Moisture Sensor Power Control GPIO"
        default 12
        help
            GPIO number to control sensor power (VCC).
            HIGH = sensor powered ON
            LOW = sensor powered OFF
            WARNING: Do NOT use ADC pins (GPIO1-5) or Flash pins (GPIO8-11)!
            Safe GPIOs: 0, 6, 7, 12-27
            Default: GPIO12

    config MOISTURE_MEASUREMENT_INTERVAL_SEC
        int "Moisture Measurement Interval (seconds)"
        default 600
        help
            Interval in seconds between moisture measurements.
            Longer intervals save more battery power.
            Recommended: 600s (10 min) for battery-powered sensors.

    config FACTORY_RESET_BUTTON_GPIO
        int "BOOT Button GPIO Pin"
        default 9
        help
            GPIO number of the BOOT button.
            Single click: triggers an immediate moisture measurement.
            Triple click: starts 30 s calibration window.
            Long press (5 s): performs a factory reset.
            Also serves as a light-sleep wake-up source.
            ESP32-H2 / C6 / C5: GPIO9

    config CALIBRATION_LED_GPIO
        int "Calibration Status LED GPIO"
        default 11
        help
            GPIO connected to an LED for calibration status feedback.
            During 30 s calibration: LED blinks at 1 Hz.
            Success: LED solid for 3 s.
            Error (range too small): LED fast-blinks 3 times.

endmenu
```
